#include "STC15Fxxxx.H"
#define DIS_DOT		0x20
#define DIS_BLACK	0x10
#define DIS_		0x11
#define		D_SCALE		10		//结果放大倍数, 放大10倍就是保留一位小数
/****************************** 用户定义宏 ***********************************/

#define		Timer0_Reload	(65536UL -(MAIN_Fosc / 1000))		//Timer 0 中断频率, 1000次/秒

/*****************************************************************************/


/*************	本地常量声明	**************/
u8 code t_display[]={						//标准字库
//	 0    1    2    3    4    5    6    7    8    9    A    B    C    D    E    F
	0x3F,0x06,0x5B,0x4F,0x66,0x6D,0x7D,0x07,0x7F,0x6F,0x77,0x7C,0x39,0x5E,0x79,0x71,
//black	 -     H    J	 K	  L	   N	o   P	 U     t    G    Q    r   M    y
	0x00,0x40,0x76,0x1E,0x70,0x38,0x37,0x5C,0x73,0x3E,0x78,0x3d,0x67,0x50,0x37,0x6e,
	0xBF,0x86,0xDB,0xCF,0xE6,0xED,0xFD,0x87,0xFF,0xEF,0x46};	//0. 1. 2. 3. 4. 5. 6. 7. 8. 9. -1

u8 code T_COM[]={0x01,0x02,0x04,0x08,0x10,0x20,0x40,0x80};		//位码

u16 code temp_table[]={
		140,	//;-40	0
		149,	//;-39	1
		159,	//;-38	2
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		3938,	//;119	159
		3942	//;120	160
};



/*************	IO口定义	**************/
sbit	P_HC595_SER   = P4^0;	//pin 14	SER		data input
sbit	P_HC595_RCLK  = P5^4;	//pin 12	RCLk	store (latch) clock
sbit	P_HC595_SRCLK = P4^3;	//pin 11	SRCLK	Shift data clock

/*************	本地变量声明	**************/

u8 	LED8[8];		//显示缓冲
u8	display_index;	//显示位索引
u16	msecond;		//1000ms计数
bit	B_1ms;			//1ms标志
//sbit P17 = P1^7;

u8  Target_tem; // 温控标准
u8	SleepDelay;	//唤醒后再进入睡眠所延时的时间
u8  hour; // 设定的倒计时
u8  min;
u8  sec;

u8 if_change;//用来判断显示是否切换&是否可以调倒计时

void	delay_ms(u8 ms);
void 	DisplayScan(void);
void	SetWakeUpTime(u16 SetTime);
void  DisplayClock(void);
u16	get_temperature(u16 adc);
u16	Get_ADC10bitResult(u8 channel);	//channel = 0~7



//========================================================================
// 函数: void	SetWakeUpTime(u16 SetTime)
// 描述: 唤醒定时器设置时间值函数。
// 参数: SetTime: 要设置的时间值(睡眠的时间), 单位为ms.
// 返回: none.
// 版本: VER1.0
// 日期: 2014-7-15
// 备注: 
//========================================================================
void	SetWakeUpTime(u16 SetTime)
{
	SetTime = (u16)((32768UL * (u32)SetTime) / 16000);	//重装值 = Fwkt/16 * SetTime/1000 = Fwkt * SetTime / 16000
	if(SetTime > 0)	SetTime--;
	WKTCL = (u8)SetTime;
	WKTCH = (u8)(SetTime >> 8) | 0x80;
}

//========================================================================
// 函数: void  delay_ms(unsigned char ms)
// 描述: 延时函数。
// 参数: ms,要延时的ms数, 这里只支持1~255ms. 自动适应主时钟.
// 返回: none.
// 版本: VER1.0
// 日期: 2013-4-1
// 备注: 
//========================================================================
void  delay_ms(u8 ms)
{
     u16 i;
	 do{
	      i = MAIN_Fosc / 13000;
		  while(--i)	;   //14T per loop
     }while(--ms);
}

/**************** 向HC595发送一个字节函数 ******************/
//HC595数码管
void Send_595(u8 dat)
{		
	u8	i;
	for(i=0; i<8; i++)
	{
		dat <<= 1;
		P_HC595_SER   = CY;
		P_HC595_SRCLK = 1;
		P_HC595_SRCLK = 0;
	}
}

/********************** 显示扫描函数 ************************/
void DisplayScan(void)
{	
	Send_595(~T_COM[display_index]);				//输出位码
	Send_595(t_display[LED8[display_index]]);	//输出段码

	P_HC595_RCLK = 1;
	P_HC595_RCLK = 0;							//锁存输出数据
	if(++display_index >= 8)	display_index = 0;	//8位结束回0
}

//========================================================================
u16	Get_ADC10bitResult(u8 channel)	//channel = 0~7
{
	ADC_RES = 0;
	ADC_RESL = 0;

	ADC_CONTR = (ADC_CONTR & 0xe0) | 0x08 | channel; 	//start the ADC
	NOP(4);

	while((ADC_CONTR & 0x10) == 0)	;	//wait for ADC finish
	ADC_CONTR &= ~0x10;		//清除ADC结束标志
	return	(((u16)ADC_RES << 2) | (ADC_RESL & 3));
}



/********************** Timer0 1ms中断函数 ************************/
void timer0 (void) interrupt TIMER0_VECTOR
{
	DisplayScan();	//1ms扫描显示一位
	B_1ms = 1;		//1ms标志
}

void display_init(void)
{
	u8 i;

	P0M1 = 0;	P0M0 = 0;	//设置为准双向口
	P1M1 = 0;	P1M0 = 0;	//设置为准双向口
	P2M1 = 0;	P2M0 = 0;	//设置为准双向口
	P3M1 = 0;	P3M0 = 0;	//设置为准双向口
	P4M1 = 0;	P4M0 = 0;	//设置为准双向口
	P5M1 = 0;	P5M0 = 0;	//设置为准双向口
	P6M1 = 0;	P6M0 = 0;	//设置为准双向口
	P7M1 = 0;	P7M0 = 0;	//设置为准双向口

	display_index = 0;
	P1ASF = 0x0C;		//P1.2 P1.3做ADC
	ADC_CONTR = 0xE0;	//90T, ADC power on

	AUXR = 0x80;	//Timer0 set as 1T, 16 bits timer auto-reload, 
	TH0 = (u8)(Timer0_Reload / 256);
	TL0 = (u8)(Timer0_Reload % 256);
	ET0 = 1;	//Timer0 interrupt enable
	TR0 = 1;	//Tiner0 run
	EA = 1;		//打开总中断

	for(i=0; i<8; i++)	LED8[i] = DIS_BLACK;	//全部消隐
	
	Target_tem = 26; // 设置标准控制温度
	SleepDelay = 0;
	hour = 0;
	min = 0;
	sec = 5;
	
	EA = 1;		//允许总中断
	
	P17 = 1;   //LED灯低电平亮，高电平熄灭
	P16 = 1;
	P47 = 1;
	P46 = 1;
	
	if_change = 1;

}



/********************  计算温度 ***********************************************/
// 计算结果: 0对应-40.0度, 400对应0度, 625对应25.0度, 最大1600对应120.0度. 
// 为了通用, ADC输入为12bit的ADC值.
// 电路和软件算法设计: Coody
/**********************************************/



u16	get_temperature(u16 adc)
{
	u16	code *p;
	u16	i;
	u8	j,k,min,max;
	
	adc = 4096 - adc;	//Rt接地
	//p = temp_table;
	if(adc < 140)		return (0xfffe);
	if(adc > 3942)	return (0xffff);

	min = 0;		//-40度
	max = 160;		//120度


	for(j=0; j<5; j++)	//对分查表
	{
		k = min / 2 + max / 2;
		if(adc <= temp_table[k])	max = k;
		else			min = k;
	}

	if(adc == p[min])	i = min * D_SCALE;
	else if(adc == p[max])	i = max * D_SCALE;
	else	// min < temp < max
	{
		while(min <= max)
		{
			min++;
			if(adc == p[min])	{i = min * D_SCALE;	break;}
			else if(adc < p[min])
			{
				min--;
				i = p[min];	//min
				j = (adc - i) * D_SCALE / (p[min+1] - i);
				i = min;
				i *= D_SCALE;
				i += j;
				break;
			}
		}
	}

	

	return i;
}


void  run_light(void){
	      P17 = 0;
        delay_ms(250);
        delay_ms(250);
        P17 = 1;
        P16 = 0;
        delay_ms(250);
        delay_ms(250);
        P16 = 1;
        P47 = 0;
        delay_ms(250);
        delay_ms(250);
        P47 = 1;
        P46 = 0;
        delay_ms(250);
        delay_ms(250);
        P46 = 1;
}

/********************** ?????? ************************/
void    DisplayClock(void)
{
    if(hour >= 10 && hour <= 23)  LED8[0] = hour / 10;
    else            LED8[0] = DIS_BLACK;
    LED8[1] = hour % 10;
    LED8[2] = DIS_;
    LED8[3] = min / 10;
    LED8[4] = min % 10;
    LED8[6] = sec / 10;
    LED8[7] = sec % 10;
    LED8[5] = DIS_;
}

